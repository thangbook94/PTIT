
byte row[8] = {0x01, 0x02, 0x04, 0x08, 0x10, 0x20, 0x40, 0x80};

byte chuHex[][8] = {
  {0x00, 0x81, 0x81, 0x81, 0x81, 0x81, 0x81, 0x00}, //A
  {0xFF, 0x01, 0x01, 0x6D, 0x6D, 0x01, 0x93, 0xFF}, //B
  {0xFF, 0x83, 0x01, 0x7D, 0x7D, 0x39, 0xBB, 0xFF}, //C
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  {0xFF, 0x3D, 0x1D, 0x4D, 0x65, 0x71, 0x79, 0xFF}, //Z
};

byte led[][8] = {0xFF, 0xFF, 0xFF, 0xFF, 0xFF, 0xFF, 0xFF, 0xFF};


String hienthi = "A";
void setup() {

  pinMode(12, OUTPUT);
  pinMode(13, OUTPUT);
  pinMode(3, OUTPUT);
  pinMode(4, OUTPUT);
  pinMode(11, OUTPUT);

}

void loop() {
//  for (int q = 0; q < hienthi.length(); q++)
//  {
//    for (int h = 0; h < 8; h++)
//    {
//      for (int j = 0; j < 7; j++)
//      {
//        led[0][j] = led[0][j + 1];
//      }
//      led[0][7] = chuHex[hienthi.charAt(q) - 'A'][h];
//      for (int w = 0; w < 75; w++)
//      {
//        for (int i = 0; i < 8; i++)
//        {
//          digitalWrite(11, LOW);
//          shiftOut(12, 13, MSBFIRST, row[i] ); // dataPin, clockPin, bitOrder, value
//          shiftOut(3, 4, MSBFIRST, led[0][i] );
//          digitalWrite(11, HIGH);
//        }
//      }
//    }
//  }


  for (int q = 0; q < hienthi.length(); q++)
  {
    for (int h = 0; h < 8; h++)
    {
      for (int w = 0; w < 50; w++)
      {
        for (int i = 0; i < 8; i++)
        {
          digitalWrite(11, LOW);
          shiftOut(12, 13, MSBFIRST, row[i]); // dataPin, clockPin, bitOrder, value
          shiftOut(3, 4, MSBFIRST, chuHex[hienthi.charAt(q) - 'A'][i] );
          digitalWrite(11, HIGH);
        }
      }
    }
  }

//  for (int q = 0; q < hienthi.length(); q++)
//  {
//    for (int h = 0; h < 8 ; h++)
//    {
//      for (int j = 0; j < 7; j++)
//      {
//        led[0][j] = led[0][j + 1];
//      }
//      led[0][7] = chuHex[hienthi.charAt(q) - 'A'][8 - h];
//      for (int w = 0; w < 75; w++)
//      {
//        for (int i = 0; i < 8; i++)
//        {
//          digitalWrite(11, LOW);
//          shiftOut(12, 13, LSBFIRST, row[i] ); // dataPin, clockPin, bitOrder, value
//          shiftOut(3, 4, MSBFIRST, led[0][i] );
//          digitalWrite(11, HIGH);
//        }
//      }
//    }
//  }
}
